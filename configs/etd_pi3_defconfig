## configs/etd_pi3_defconfig
```kconfig
BR2_arm=y
BR2_cortex_a53=y
BR2_ARM_FPU_NEON_VFPV4=y

BR2_TOOLCHAIN_BUILDROOT_GLIBC=y
BR2_TOOLCHAIN_BUILDROOT_CXX=y
BR2_PACKAGE_HOST_GDB_ARCH_SUPPORTS=y
BR2_PACKAGE_HOST_GDB=y
BR2_GDB_VERSION_8_2=y
BR2_GDB_VERSION="8.2.1"

BR2_SYSTEM_DHCP="eth0"

BR2_TARGET_ENABLE_ROOT_LOGIN=y
BR2_TARGET_GENERIC_ROOT_PASSWD="etd123"
BR2_TARGET_GENERIC_HOSTNAME="etdpi3"
BR2_TARGET_GENERIC_ISSUE="Welcome to ETD PI3"
BR2_TARGET_GENERIC_PASSWD_SHA256=y
BR2_TARGET_GENERIC_PASSWD_METHOD="sha-256"


# Linux headers same as kernel, a 4.19 series
BR2_PACKAGE_HOST_LINUX_HEADERS_CUSTOM_4_19=y

BR2_LINUX_KERNEL=y
BR2_LINUX_KERNEL_CUSTOM_TARBALL=y
BR2_LINUX_KERNEL_CUSTOM_TARBALL_LOCATION="$(call github,etuxdroid,linux,5eeff139ea9135db6e01a58ef613338f1d0899d8)/5eeff139ea9135db6e01a58ef613338f1d0899d8.tar.gz"
BR2_LINUX_KERNEL_DEFCONFIG="bcm2709"
BR2_LINUX_KERNEL_CONFIG_FRAGMENT_FILES="board/etd/pi3/linux.fragment"
# Build the DTB from the kernel sources
BR2_LINUX_KERNEL_DTS_SUPPORT=y
BR2_LINUX_KERNEL_INTREE_DTS_NAME="bcm2710-rpi-3-b bcm2710-rpi-3-b-plus bcm2710-rpi-cm3"

BR2_LINUX_KERNEL_NEEDS_HOST_OPENSSL=y

BR2_PACKAGE_RPI_FIRMWARE=y

# Required tools to create the SD image
BR2_PACKAGE_HOST_DOSFSTOOLS=y
BR2_PACKAGE_HOST_GENIMAGE=y
BR2_PACKAGE_HOST_MTOOLS=y
BR2_ROOTFS_DEVICE_CREATION_DYNAMIC_MDEV=y

BR2_PACKAGE_DROPBEAR=y
#BR2_PACKAGE_DROPBEAR_CLIENT=y
# BR2_PACKAGE_DROPBEAR_DISABLE_REVERSEDNS is not set
BR2_PACKAGE_DROPBEAR_SMALL=y
# BR2_PACKAGE_DROPBEAR_WTMP is not set
# BR2_PACKAGE_DROPBEAR_LASTLOG is not set
# BR2_PACKAGE_DROPBEAR_LEGACY_CRYPTO is not set
#BR2_PACKAGE_DROPBEAR_LOCALOPTIONS_FILE=""


# added these last
#BR2_PACKAGE_OPENSSH=y


# Build Qt5 WebEngine
BR2_PACKAGE_LIBERATION=y
#BR2_PACKAGE_QT5=y
#BR2_PACKAGE_QT5BASE_EXAMPLES=y
#BR2_PACKAGE_QT5BASE_GIF=y
#BR2_PACKAGE_QT5BASE_JPEG=y
#BR2_PACKAGE_QT5BASE_PNG=y
#BR2_PACKAGE_QT5WEBENGINE=y
#BR2_PACKAGE_QT5WEBENGINE_PROPRIETARY_CODECS=y
BR2_PACKAGE_RPI_FIRMWARE=y
BR2_PACKAGE_RPI_USERLAND=y
BR2_PACKAGE_CA_CERTIFICATES=y
BR2_PACKAGE_NTP=y

BR2_PACKAGE_ETD_THERM=y

# end added last

# Filesystem / image
BR2_TARGET_ROOTFS_EXT2=y
BR2_TARGET_ROOTFS_EXT2_4=y
BR2_TARGET_ROOTFS_EXT2_SIZE="360M"
# BR2_TARGET_ROOTFS_TAR is not set
BR2_ROOTFS_POST_BUILD_SCRIPT="board/etd/pi3/post-build.sh"
BR2_ROOTFS_POST_IMAGE_SCRIPT="board/etd/pi3/post-image.sh"
BR2_ROOTFS_OVERLAY="board/etd/pi3/rootfs_overlay"
BR2_ROOTFS_POST_SCRIPT_ARGS="--add-pi3-miniuart-bt-overlay --add-w1-gpio --add-spi"
```

## package/etd_therm/Config.in
```kconfig
config BR2_PACKAGE_ETD_THERM
	bool "etd_therm"
	help
	  ETD Thermostat package.

	  http://etuxdroid.tech
```
